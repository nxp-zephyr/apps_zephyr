## west.yml
```yaml
manifest:
  defaults:
    remote: zephyrproject-rtos

  remotes:
    - name: zephyrproject-rtos
      url-base: https://github.com/zephyrproject-rtos
    - name: nxp-appcodehub
      url-base: https://github.com/nxp-appcodehub
    - name: nxp-forks
      url-base: https://github.com/NXP-Zephyr
    - name: nxp-upstream
      url-base: https://github.com/nxp-upstream
  projects:
    - name: nxp-zephyr
      remote: nxp-forks
      revision: 9f2bc109df5091b5c71f810cf49c59caed560849
      path: zephyr
      import: false
      west-commands: scripts/west-commands.yml
      import:
        # Clone CMSIS version used by Zephyr manifest
        name-allowlist:
          - cmsis
    - name: hal_nxp
      remote: nxp-forks
      revision: 74f200945c4497bc913a4ab9758470aa1dcc1504
      path: modules/hal/nxp
      groups:
        - hal
    - name: lvgl
      revision: e4339eb7989697becdfc696586531cfca02a3ebd
      remote: nxp-upstream
      path: modules/lib/gui/lvgl
    - name: ap-dvs-pvt-sensor
      remote: nxp-appcodehub
      revision: fc62a7895ff3a590b11df6791fe398ace23216f3
      path: modules/hal/appswpacks-dvs-pvt-sensor
  self:
    path: nxp
```
